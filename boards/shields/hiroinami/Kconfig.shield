## boards/shields/hiroinami/Kconfig.shield
```kconfig
config SHIELD_HIROINAMI_LEFT
    def_bool $(shields_list_contains, hiroinami_left)

config SHIELD_HIROINAMI_RIGHT
    def_bool $(shields_list_contains, hiroinami_right)
```
